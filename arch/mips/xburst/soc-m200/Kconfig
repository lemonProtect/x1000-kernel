## arch/mips/xburst/soc-m200/Kconfig
```kconfig
choice
	prompt "PRODUCT type"
	depends on SOC_M200
	default PRODUCT_DEVELOP

config BOARD_4785_FPGA
       bool "FPGA"

config PRODUCT_DEVELOP
       bool "DEVELOP"

config BOARD_FORNAX
       bool "FORNAX"
endchoice

config PRODUCT_NAME
	string
	default "fpga" if BOARD_4785_FPGA
	default "dorado" if PRODUCT_DEVELOP
	default "fornax" if BOARD_FORNAX

if PRODUCT_DEVELOP
source "arch/mips/xburst/soc-m200/board/dorado/Kconfig"
endif
```

## arch/mips/xburst/soc-m200/board/newton/Kconfig
```kconfig
choice
	prompt "BOARD type"
	depends on BOARD_NEWTON
	default BOARD_NEWTON2_V20


config BOARD_NEWTON2_V20
       bool "board newton2 v20"
       depends on BOARD_NEWTON

endchoice

config BOARD_NAME
	string
	default "newton2_v20" if BOARD_NEWTON2_V20
```

## arch/mips/xburst/soc-m200/chip-m200/Kconfig
```kconfig
choice
	prompt "Board type"
	depends on CHIP_M200
	default PRODUCT_DEVELOP

config BOARD_4785_FPGA
       bool "FPGA"

config PRODUCT_DEVELOP
       bool "DEVELOP"

config PRODUCT_NEWTON
       bool "NEWTON"

endchoice

config PRODUCT_NAME
	string
	default "fpga" if BOARD_4785_FPGA
	default "dorado" if PRODUCT_DEVELOP
	default "newton" if PRODUCT_NEWTON

if PRODUCT_DEVELOP
source "arch/mips/xburst/soc-m200/chip-m200/dorado/Kconfig"
endif

if PRODUCT_NEWTON
source "arch/mips/xburst/soc-m200/chip-m200/newton/Kconfig"
endif
```

## arch/mips/xburst/soc-x1000/chip-x1000/Kconfig
```kconfig
choice
	prompt "Board type"
	depends on SOC_X1000
	default PRODUCT_X1000_PHOENIX

config  PRODUCT_X1000_PHOENIX
    bool "product x1000 phoenix"

endchoice

if PRODUCT_X1000_PHOENIX
config PRODUCT_NAME
string
default "phoenix"
source "arch/mips/xburst/soc-x1000/chip-x1000/phoenix/Kconfig"
endif
```

## drivers/misc/jz_dmmu/Kconfig
```kconfig
config JZ_DMMU_V12
	bool "Dmmu V12 Driver"
	help
	  Support for Ingenic dmmu v12 operations.
```
